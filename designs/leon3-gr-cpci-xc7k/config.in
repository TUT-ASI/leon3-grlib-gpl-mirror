## designs/leon3-gr-cpci-xc7k/config.in
```kconfig
#
# LEON4 configuration written in linux configuration language
#
# Written by Fredrik Ringhage, Gaisler Research
#
# Comments and bug reports to ringhage@gaisler.com
#
#

#define_bool CONFIG_MCTRL_RMW y
define_bool CONFIG_HAS_SHARED_GRFPU y

mainmenu_name "LEON4MP Design Configuration"

mainmenu_option next_comment
  comment 'Synthesis      '
  source lib/techmap/gencomp/tech.in
endmenu

mainmenu_option next_comment
  comment 'Clock generation'
  source lib/techmap/clocks/clkgen.in
endmenu

source lib/gaisler/subsys/leon_dsu_stat_base.in
source lib/gaisler/l2cache/l2c.in
source lib/grlib/amba/amba.in

mainmenu_option next_comment
  comment 'Debug Link           '
  source lib/gaisler/uart/dcom.in
  source lib/gaisler/jtag/jtag.in
  source lib/gaisler/net/edcl.in
endmenu

mainmenu_option next_comment
comment 'Peripherals             '

  mainmenu_option next_comment
  comment 'Memory controller             '
    source lib/esa/memoryctrl/mctrl.in
    source lib/gaisler/ddr/mig_7series.in
    source lib/gaisler/misc/ahbstat.in
  endmenu

  mainmenu_option next_comment
  comment 'On-chip RAM/ROM                 '
    source lib/gaisler/misc/ahbrom.in
    source lib/gaisler/misc/ahbram.in
  endmenu
  
  mainmenu_option next_comment
  comment 'SpaceWire '
    source lib/gaisler/spacewire/spacewire.in
    bool 'Select LVDS drivers' CONFIG_SPW_LVDS
  endmenu

  mainmenu_option next_comment
  comment 'Ethernet             '
    source lib/gaisler/greth/greth.in
  endmenu

  mainmenu_option next_comment
  comment 'UARTs, timers and irq control         '
    source lib/gaisler/uart/uart1.in
    source lib/gaisler/uart/uart2.in
    source lib/gaisler/irqmp/irqmp.in
    source lib/gaisler/misc/gptimer.in
    source lib/gaisler/misc/grgpio.in
    source lib/gaisler/i2c/i2c.in
  endmenu

  mainmenu_option next_comment
  comment 'SPI'
    source lib/gaisler/spi/spimctrl.in
  endmenu

  mainmenu_option next_comment
  comment 'GRCAN'
    source lib/gaisler/can/grcan.in
  endmenu
  
  mainmenu_option next_comment
  comment 'PCI              '
    mainmenu_option next_comment
    comment 'GRPCI1         '
    source lib/gaisler/pci/grpci1/pci_target.in
    source lib/gaisler/pci/grpci1/pci_mtf.in
    source lib/gaisler/pci/grpci1/pcidma.in
    source lib/gaisler/pci/grpci1/pci.in
    endmenu
    mainmenu_option next_comment
    comment 'GRPCI2         '
      source lib/gaisler/pci/grpci2/grpci2.in
    endmenu
    source lib/esa/pci/pci_arb.in
    source lib/gaisler/pci/pcitrace/pcitrace.in
  endmenu

endmenu

mainmenu_option next_comment
comment 'VHDL Debugging        '
  source lib/grlib/util/debug.in
endmenu
```

## designs/leon3-gr740-mini-board/config.in
```kconfig
# LEON3 configuration written in linux configuration language
#
# Comments and bug reports to support@gaisler.com
#
#

mainmenu_name "LEON3MP Design Configuration"

mainmenu_option next_comment
  comment 'Synthesis      '
  source lib/techmap/gencomp/tech.in
endmenu

mainmenu_option next_comment
  comment 'Clock generation'
  source lib/techmap/clocks/clkgen.in
endmenu

source lib/gaisler/subsys/leon_dsu_stat_base.in
source lib/grlib/amba/amba.in

mainmenu_option next_comment
  comment 'Debug Link           '
  source lib/gaisler/uart/dcom.in
  source lib/gaisler/jtag/jtag.in
endmenu

mainmenu_option next_comment
comment 'Peripherals             '

  mainmenu_option next_comment
  comment 'On-chip RAM                 '
    comment 'AHBRAM           '
    source lib/gaisler/misc/ahbram.in
    comment 'FTAHBRAM           '
    source lib/gaisler/misc/ftahbram.in
  endmenu
  source lib/gaisler/misc/ahbstat.in
  source lib/gaisler/spi/spimctrl.in

  

  mainmenu_option next_comment
  comment 'UART, timer, I/O port and interrupt controller'
    source lib/gaisler/uart/uart1.in
    source lib/gaisler/irqmp/irqmp.in
    source lib/gaisler/misc/gptimer.in
    source lib/gaisler/misc/grgpio.in
  endmenu

  mainmenu_option next_comment
  comment 'PCI'
    source lib/gaisler/pci/grpci2/grpci2.in
  endmenu

endmenu

mainmenu_option next_comment
comment 'VHDL Debugging        '
  source lib/grlib/util/debug.in
endmenu
```

## designs/leon3-lattice-lfcpnx-evn/config.in
```kconfig
# LEON3 configuration written in linux configuration language
#
# Comments and bug reports to support@gaisler.com
#
#

mainmenu_name "LEON3MP Design Configuration"

mainmenu_option next_comment
  comment 'Synthesis      '
  source lib/techmap/gencomp/tech.in
endmenu

source lib/gaisler/subsys/leon_dsu_stat_base.in
source lib/grlib/amba/amba.in

mainmenu_option next_comment
  comment 'Debug Link           '
  source lib/gaisler/uart/dcom.in
  source lib/gaisler/jtag/jtag.in
endmenu

mainmenu_option next_comment
comment 'Peripherals             '

  mainmenu_option next_comment
  comment 'On-chip RAM                 '
    comment 'AHBRAM           '
    source lib/gaisler/misc/ahbram.in
    comment 'FTAHBRAM           '
    source lib/gaisler/misc/ftahbram.in
  endmenu
  mainmenu_option next_comment
  comment 'AHB Status Registers        '
    source lib/gaisler/misc/ahbstat.in
  endmenu

  source lib/gaisler/spi/spimctrl.in

  mainmenu_option next_comment
  comment 'CAN	'
    source lib/gaisler/can/grcan.in
  endmenu

  mainmenu_option next_comment
  comment 'CAN FD     '
    source lib/gaisler/canfd/grcanfd.in
  endmenu

  mainmenu_option next_comment
  comment 'Spacewire '
    source lib/gaisler/spacewire/spacewire.in
  endmenu

  mainmenu_option next_comment
  comment 'HSSL      '
    source lib/gaisler/hssl/hssl.in
  endmenu

  mainmenu_option next_comment
  comment 'UART, timer, I/O port and interrupt controller'
    comment 'UART           '
    source lib/gaisler/uart/uart1.in
    comment 'IRQ           '
    source lib/gaisler/irqmp/irqmp.in
    comment 'TIMER           '
    source lib/gaisler/misc/gptimer.in
    comment 'GPIO           '
    source lib/gaisler/misc/grgpio.in
  endmenu

endmenu

mainmenu_option next_comment
comment 'VHDL Debugging        '
  source lib/grlib/util/debug.in
endmenu
```

## designs/leon5-lattice-lfcpnx-versa-evn/config.in
```kconfig
#
# LEON5 configuration written in linux configuration language
#
#
# Comments and bug reports to support@gaisler.com
#
#

mainmenu_name "LEON5 Design Configuration"

mainmenu_option next_comment
  comment 'Synthesis      '
  source lib/techmap/gencomp/tech.in
endmenu

source lib/gaisler/leon5/leon5.in

mainmenu_option next_comment
  comment 'Debug Link           '
  source lib/gaisler/uart/dcom.in
  source lib/gaisler/jtag/jtag.in
endmenu

mainmenu_option next_comment
comment 'Peripherals             '

  mainmenu_option next_comment
  comment 'AHB Status Register             '
    source lib/gaisler/misc/ahbstat.in
  endmenu

  mainmenu_option next_comment
  comment 'On-chip RAM/ROM                 '
    source lib/gaisler/misc/ahbrom.in
    source lib/gaisler/misc/ahbram.in
  endmenu

  mainmenu_option next_comment
  comment 'GPIO'
    source lib/gaisler/misc/grgpio.in
  endmenu

endmenu

mainmenu_option next_comment
comment 'VHDL Debugging        '
  source lib/gaisler/leon5/debug5.in
endmenu
```

## designs/leon5-xilinx-kcu105/config.in
```kconfig
#
# LEON5 configuration written in linux configuration language
#
#
# Comments and bug reports to support@gaisler.com
#
#

mainmenu_name "LEON5 Design Configuration"

mainmenu_option next_comment
  comment 'Synthesis      '
  source lib/techmap/gencomp/tech.in
endmenu

mainmenu_option next_comment
  comment 'Clock generation'
  source lib/techmap/clocks/clkgen.in
endmenu

source lib/gaisler/leon5/leon5.in
source lib/gaisler/l2cache/l2c.in

mainmenu_option next_comment
  comment 'Debug Link           '
  source lib/gaisler/uart/dcom.in
  source lib/gaisler/jtag/jtag.in
  source lib/gaisler/net/edcl.in
endmenu

mainmenu_option next_comment
comment 'Peripherals             '

  mainmenu_option next_comment
  comment 'Memory controller             '
    source lib/gaisler/ddr/mig_7series.in
    source lib/gaisler/misc/ahbstat.in
  endmenu

  mainmenu_option next_comment
  comment 'On-chip RAM/ROM                 '
    source lib/gaisler/misc/ahbrom.in
    source lib/gaisler/misc/ahbram.in
  endmenu

  mainmenu_option next_comment
  comment 'Ethernet             '
    source lib/gaisler/greth/greth.in
  endmenu

  mainmenu_option next_comment
  comment 'GPIO'
    source lib/gaisler/misc/grgpio.in
  endmenu

  mainmenu_option next_comment
  comment 'I2C'
    source lib/gaisler/i2c/i2c.in
  endmenu


endmenu

mainmenu_option next_comment
comment 'VHDL Debugging        '
  source lib/gaisler/leon5/debug5.in
endmenu
```

## designs/noelv-generic/config.in
```kconfig
#
# Configuration written in linux configuration language
#
# Written by Fredrik Ringhage, Gaisler Research
#
# Comments and bug reports to ringhage@gaisler.com
#
#

#define_bool CONFIG_MCTRL_RMW y
define_bool CONFIG_HAS_SHARED_GRFPU y

mainmenu_name "NOELV Design Configuration"

mainmenu_option next_comment
  comment 'Synthesis      '
  source lib/techmap/gencomp/tech.in
endmenu

mainmenu_option next_comment
  comment 'Clock generation'
  source lib/techmap/clocks/clkgen.in
endmenu

source lib/gaisler/noelv/noelv.in
source lib/gaisler/l2cache/l2c.in
source lib/grlib/amba/amba.in

mainmenu_option next_comment
  comment 'Debug Link           '
  source lib/gaisler/uart/dcom.in
  source lib/gaisler/jtag/jtag.in
#  source lib/gaisler/usb/grusb_dcl.in
  source lib/gaisler/net/edcl.in
endmenu

mainmenu_option next_comment
comment 'Peripherals             '

  mainmenu_option next_comment
  comment 'Memory controller             '
#    source lib/esa/memoryctrl/mctrl.in
    source lib/gaisler/misc/ahbstat.in
  endmenu

#  mainmenu_option next_comment
#  comment 'On-chip RAM/ROM                 '
#    source lib/gaisler/misc/ahbrom.in
#    source lib/gaisler/misc/ahbram.in
#  endmenu

  mainmenu_option next_comment
  comment 'Ethernet             '
    source lib/gaisler/greth/greth.in
  endmenu

  mainmenu_option next_comment
  comment 'UARTs, timers and irq control         '
#    source lib/gaisler/uart/uart1.in
#    source lib/gaisler/misc/gptimer.in
    source lib/gaisler/misc/grgpio.in
#    source lib/gaisler/i2c/i2c.in
  endmenu

#  mainmenu_option next_comment
#  comment 'SPI'
#    source lib/gaisler/spi/spictrl.in
#  endmenu

endmenu

mainmenu_option next_comment
comment 'VHDL Debugging        '
  source lib/grlib/util/debug.in
endmenu

#mainmenu_option next_comment
#comment 'Version number        '
#  source lib/gaisler/misc/grversion.in
#endmenu
```

## software/noelv/tests/zephyr/boards/grlib-noelv/Kconfig.board
```kconfig
#
# Copyright (c) 2018 - 2019 Antmicro <www.antmicro.com>
#
# SPDX-License-Identifier: Apache-2.0
#

config BOARD_GRLIB_NOELV
	bool "Board with NOEL-V CPU in GRLIB"
	depends on SOC_RISCV64_GRLIB_NOELV
```

## software/noelv/tests/zephyr/boards/grlib-noelv/Kconfig.defconfig
```kconfig
#
# Copyright (c) 2018 - 2019 Antmicro <www.antmicro.com>
#
# SPDX-License-Identifier: Apache-2.0
#

if BOARD_GRLIB_NOELV

config BOARD
	default "grlib_noelv"

endif
```

## software/noelv/tests/zephyr/boards/grlib-noelv/noelv_defconfig
```kconfig
#
# Copyright (c) 2019 Antmicro <www.antmicro.com>
#
# SPDX-License-Identifier: Apache-2.0
#

CONFIG_RISCV=y
CONFIG_SOC_RISCV64_GRLIB_NOELV=y
CONFIG_BOARD_GRLIB_NOELV=y
CONFIG_CONSOLE=y
CONFIG_SERIAL=y
CONFIG_UART_APBUART=y
CONFIG_APBUART0=y
#CONFIG_UART_CONSOLE=y
CONFIG_RAM_CONSOLE=y
CONFIG_ETH_LITEETH=y
CONFIG_ETH_LITEETH_0=y
CONFIG_NET_L2_ETHERNET=y
CONFIG_HWINFO=y
CONFIG_HWINFO_LITEX=y
```

## software/noelv/tests/zephyr/drivers/Kconfig.uart_apbuart
```kconfig
menuconfig UART_APBUART
	bool "ABPUART driver"
	depends on LEON || SOC_RISCV64_GRLIB_NOELV
	select SERIAL_HAS_DRIVER 
	help 
	  This option enables the UARTx driver for Leon processors. 

config APBUART0
	bool "Enable APBUART0"
	depends on UART_APBUART
	help 
	  Enable APBUART0 at boot.
```

## software/noelv/tests/zephyr/soc/grlib-noelv/Kconfig.defconfig
```kconfig
#
# Copyright (c) 2018 - 2019 Antmicro <www.antmicro.com>
#
# SPDX-License-Identifier: Apache-2.0
#

if SOC_RISCV64_GRLIB_NOELV

config SOC
	string
	default "grlib-noelv"

config SYS_CLOCK_HW_CYCLES_PER_SEC
	int
	default 100000000

config RISCV_HAS_CPU_IDLE
	bool

config RISCV_HAS_PLIC
	bool

config NUM_IRQS
	int
	default 16

CONFIG_64BIT=y

endif # SOC_RISCV64_GRLIB_NOELV
```

## software/noelv/tests/zephyr/soc/grlib-noelv/Kconfig.soc
```kconfig
#
# Copyright (c) 2018 - 2019 Antmicro <www.antmicro.com>
#
# SPDX-License-Identifier: Apache-2.0
#

config SOC_RISCV64_GRLIB_NOELV
	bool "GRLIB NOEL-V system implementation"
```
